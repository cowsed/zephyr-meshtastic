## Kconfig
```kconfig
rsource "lib/Kconfig"
rsource "drivers/Kconfig"

config MESHTASTIC
	bool "enable meshtastic subsystem"
	select LORA_BASICS_MODEM_DRIVERS
	select ZBUS
	select NANOPB
	select BASE64
	select SETTINGS
	help
		Idk something
```

## drivers/Kconfig
```kconfig
menu "Drivers"
rsource "lora/Kconfig"
rsource "dai/max98357/Kconfig"
rsource "misc/aw9364/Kconfig"
endmenu
```

## drivers/i2s/max98357/Kconfig
```kconfig
# Analog Devices Speaker Amp

# Copyright (c) 2025 Launch Initiative
# SPDX-License-Identifier: Apache-2.0

menuconfig MAX98357
	bool "MAX98357 Speaker Amp"
	default y
	depends on DT_HAS_ADI_MAX98357_ENABLED
	select I2S
	help
	  Enable driver for MAX98357 Speaker Amp.
```

## drivers/lora/generic_lora/Kconfig
```kconfig
menuconfig GENERIC_LORA
	bool "Generic lora device for testing"
	default y
	depends on DT_HAS_GENERIC_LORA_ENABLED
	help
	  Enable driver for lora test
```

## dts/bindings/dai/adi,max98357.yaml
```yaml
# Copyright (c) 2025 Launch Initiative
# SPDX-License-Identifier: Apache-2.0
# datasheet: https://www.analog.com/media/en/technical-documentation/data-sheets/max98357a-max98357b.pdf

description: Analog Devices Speaker Amp

compatible: "adi,max98357"

include: [i2s-device.yaml]

properties:
  sd-mode-gpios:
    required: true
    type: phandle-array
    description: GPIO spec for sd mode pin
```

## dts/bindings/lora/generic,lora.yaml
```yaml
description: Generic Test LoRa

compatible: "generic,lora"

include: [base.yaml]
```

## lib/Kconfig
```kconfig
config MESHTASTIC_SHELL
	bool "meshtastic shell"
	depends on SHELL
	help
		enable debug meshtastic shell
```
