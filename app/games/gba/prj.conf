## CMakeLists.txt
```
# SPDX-License-Identifier: Apache-2.0

cmake_minimum_required(VERSION 3.20.0)
find_package(Zephyr REQUIRED HINTS $ENV{ZEPHYR_BASE})
project(display)

target_sources(app PRIVATE src/main.cpp src/rom.cpp)
```

## prj.conf
```kconfig
CONFIG_HEAP_MEM_POOL_SIZE=100080
CONFIG_LOG=y
CONFIG_DISPLAY=y
CONFIG_SPI=y
CONFIG_MAIN_STACK_SIZE=128000
CONFIG_DEBUG=y
CONFIG_CPP=y`
```

## src/rom.h
```c
#include <stdint.h>

extern const int rom_size;

extern uint8_t *rom_data;
```
