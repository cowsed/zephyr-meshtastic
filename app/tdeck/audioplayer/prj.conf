## CMakeLists.txt
```
# SPDX-License-Identifier: Apache-2.0

cmake_minimum_required(VERSION 3.20.0)

find_package(Zephyr REQUIRED HINTS $ENV{ZEPHYR_BASE})
project(i2s_output)

target_sources(app PRIVATE src/main.c src/audio_thread.c)
```

## prj.conf
```kconfig
CONFIG_LORA_BASICS_MODEM_DRIVERS_RAL_RALF=y
CONFIG_LORA_BASICS_MODEM_DRIVERS=y
CONFIG_SEMTECH_SX126X=y

CONFIG_FS_FATFS_LFN=y
CONFIG_FILE_SYSTEM=y
CONFIG_FILE_SYSTEM_LIB_LINK=y
CONFIG_FILE_SYSTEM_SHELL=y
CONFIG_FAT_FILESYSTEM_ELM=y
CONFIG_DISK_ACCESS=y
CONFIG_I2S=y
#CONFIG_MAX98357=y
CONFIG_MESHTASTIC=y
CONFIG_I2S_ESP32=y
#CONFIG_DAI=y
CONFIG_SHELL=y
CONFIG_GPIO_SHELL=y
#CONFIG_FS_SHELL=y
CONFIG_FS_FATFS_MOUNT_MKFS=n


CONFIG_LOG=y
CONFIG_SHELL_LOG_BACKEND=y
CONFIG_DEBUG=y
CONFIG_MAIN_STACK_SIZE=60384
```

## src/main.c
```c
/*
 * Copyright 2023 NXP
 *
 * SPDX-License-Identifier: Apache-2.0
 */
#include <zephyr/drivers/i2s.h>

#include <ff.h>
#include <stdio.h>
#include <zephyr/fs/fs.h>
#include <zephyr/kernel.h>
#include <zephyr/logging/log.h>
#include <zephyr/storage/disk_access.h>
#include <zephyr/sys/iterable_sections.h>
LOG_MODULE_REGISTER(main, LOG_LEVEL_INF);

#define DISK_DRIVE_NAME "SD"

#define DISK_MOUNT_PT "/" DISK_DRIVE_NAME ":"

static FATFS fat_fs;
/* mounting info */
static struct fs_mount_t mp = {
    .type = FS_FATFS,
    .fs_data = &fat_fs,
};
#define FS_RET_OK FR_OK

static const char *disk_mount_pt = DISK_MOUNT_PT;

int play_file(const char *filename);
int main() {
  /* raw disk i/o */
  do {
    static const char *disk_pdrv = DISK_DRIVE_NAME;
    uint64_t memory_size_mb;
    uint32_t block_count;
    uint32_t block_size;

    if (disk_access_ioctl(disk_pdrv, DISK_IOCTL_CTRL_INIT, NULL) != 0) {
      LOG_ERR("Storage init ERROR!");
      break;
    }

    if (disk_access_ioctl(disk_pdrv, DISK_IOCTL_GET_SECTOR_COUNT,
                          &block_count)) {
      LOG_ERR("Unable to get sector count");
      break;
    }
    LOG_INF("Block count %u", block_count);

    if (disk_access_ioctl(disk_pdrv, DISK_IOCTL_GET_SECTOR_SIZE, &block_size)) {
      LOG_ERR("Unable to get sector size");
      break;
    }
    printk("Sector size %u\n", block_size);

    memory_size_mb = (uint64_t)block_count * block_size;
    printk("Memory Size(MB) %u\n", (uint32_t)(memory_size_mb >> 20));

    if (disk_access_ioctl(disk_pdrv, DISK_IOCTL_CTRL_DEINIT, NULL) != 0) {
      LOG_ERR("Storage deinit ERROR!");
      break;
    }
  } while (0);

  mp.mnt_point = disk_mount_pt;

  printf("mounting\n");

  int res = fs_mount(&mp);

  if (res == FS_RET_OK) {
    printk("Disk mounted.\n");
  } else {
    printk("Disk not mounted :(\n");
  }
  k_msleep(1050);
  // play_file("/SD:/Audio/spinningfish.raw");
  play_file("/SD:/Audio/supergraphicultramodern.raw");

  return 0;
}
```

## src/audio_thread.c
```c
#include <stddef.h>
#include <zephyr/drivers/i2s.h>
#include <zephyr/fs/fs.h>
#include <zephyr/kernel.h>
#include <zephyr/logging/log.h>
#include <zephyr/storage/disk_access.h>
LOG_MODULE_REGISTER(audio, LOG_LEVEL_INF);

static const char *current_file_name = NULL;
static size_t file_size = 0;
static size_t samples_per_second = 0;
static struct fs_file_t current_file;
static bool paused = false;
static bool newfile = false;

bool has_current() { return current_file_name != NULL; }

#define SAMPLE_NO 128
#define NUM_BLOCKS 40

#define BLOCK_SIZE (2 * 2 * SAMPLE_NO)

K_MEM_SLAB_DEFINE(tx_0_mem_slab, BLOCK_SIZE, NUM_BLOCKS, 2);

int setup_i2s(const struct device *dev_i2s, size_t clk_freq) {
  struct i2s_config i2s_cfg;
  int ret;

  if (!device_is_ready(dev_i2s)) {
    printf("I2S device not ready\n");
    return -ENODEV;
  }
  printf("I2S device ready\n");
  /* Configure I2S stream */
  i2s_cfg.word_size = 16U;
  i2s_cfg.channels = 2U;
  i2s_cfg.format = I2S_FMT_DATA_FORMAT_I2S;
  i2s_cfg.frame_clk_freq = clk_freq;
  i2s_cfg.block_size = BLOCK_SIZE;
  i2s_cfg.timeout = 15000;
  /* Configure the Transmit port as Master */
  i2s_cfg.options = I2S_OPT_FRAME_CLK_MASTER | I2S_OPT_BIT_CLK_MASTER;
  i2s_cfg.mem_slab = &tx_0_mem_slab;
  ret = i2s_configure(dev_i2s, I2S_DIR_TX, &i2s_cfg);
  if (ret < 0) {
    printf("Failed to configure I2S stream\n");
    return ret;
  }
  return 0;
}

int readblock(struct fs_file_t *fp, void *into) {
  int16_t buf[SAMPLE_NO] = {0};
  int num_read = fs_read(fp, buf, sizeof(buf));
  int16_t *outp = into;
  int att = 5;
  for (int i = 0; i < SAMPLE_NO; i++) {
    outp[i * 2] = buf[i] >> att;
    outp[i * 2 + 1] = buf[i] >> att;
  }
  return num_read;
}

int play_file(const char *filename) { return open_current(filename); }

void pause() {}

void resume() {}

#define AUDIO_STACK_SIZE 4096
#define AUDIO_PRIORITY 5

int close_current() {
  if (!has_current()) {
    return 0;
  }
  int ret = fs_close(&current_file);
  file_size = 0;
  samples_per_second = 0;
  paused = false;
  current_file_name = NULL;
  return ret;
}

int open_current(const char *fname) {
  int ret = fs_open(&current_file, fname, FS_O_READ);
  if (ret != 0) {
    return ret;
  }
  current_file_name = fname;
  newfile = true;
  fs_seek(&current_file, 0, FS_SEEK_END);
  size_t size = fs_tell(&current_file);
  file_size = size;
  fs_seek(&current_file, 0, FS_SEEK_SET);
  return 0;
}

extern int audio_entry_point(void *, void *, void *) {
  fs_file_t_init(&current_file);
  const struct device *dev_i2s = DEVICE_DT_GET(DT_ALIAS(i2s_tx));
  setup_i2s(dev_i2s, 8000);
  while (true) {
    if (!has_current()) {
      LOG_INF("No Current File");
      k_msleep(100);
      continue;
    }
    if (!paused) {
      void *my_block;
      int ret = k_mem_slab_alloc(&tx_0_mem_slab, &my_block, K_FOREVER);
      if (ret != 0) {
        LOG_ERR("error allocating\n");
      }
      int num_read = readblock(&current_file, my_block);
      if (num_read != SAMPLE_NO * 2) {
        LOG_INF("Read %d of %d", num_read, SAMPLE_NO * 2);
        ret = i2s_trigger(dev_i2s, I2S_DIR_TX, I2S_TRIGGER_DRAIN);
        if (ret < 0) {
          LOG_ERR("Could not trigger I2S tx\n");
          continue;
        }
        close_current();
      }
      /* Send block */
      ret = i2s_write(dev_i2s, my_block, BLOCK_SIZE);
      if (ret < 0) {
        printf("Could not write TX buffer: err %d\n", ret);
        // ret = i2s_trigger(dev_i2s, I2S_DIR_TX, I2S_TRIGGER_DRAIN);
        // if (ret < 0) {
        //   printf("Could not trigger I2S tx\n");
        // return ret;
        // }
        // newfile = true;
      }

      if (newfile) {
        /* Trigger the I2S transmission */
        ret = i2s_trigger(dev_i2s, I2S_DIR_TX, I2S_TRIGGER_START);
        newfile = false;
        if (ret < 0) {
          newfile = true;
          printf("Could not trigger I2S tx: err %d\n", ret);
          continue;
        }
      }
    }
  }
}

//   printf("Starting playback\n");
//   struct fs_file_t fil;
//   int ret = fs_open(&fil, "/SD:/Audio/spinningfish.raw", FS_O_READ);
//   if (ret != 0) {
//     printf("Error opening file: %d\n", ret);
//     return 0;
//   }

//   printf("I2S ready\n");
//   printf("num read: %d\n", num_read);

//   /* Send first block */
//   ret = i2s_write(dev_i2s, my_block, BLOCK_SIZE);
//   if (ret < 0) {
//     printf("Could not write TX buffer: err %d\n", ret);
//     return ret;
//   }

//   /* Trigger the I2S transmission */
//   ret = i2s_trigger(dev_i2s, I2S_DIR_TX, I2S_TRIGGER_START);
//   if (ret < 0) {
//     printf("Could not trigger I2S tx: err %d\n", ret);
//     return ret;
//   }
//   printf("Started\n");
//   //
//   while (num_read == SAMPLE_NO * 2) {
//     void *my_block;
//     int ret = k_mem_slab_alloc(&tx_0_mem_slab, &my_block, K_FOREVER);
//     if (ret < 0) {
//       printf("Failed to allocate TX block\n");
//       return ret;
//     }
//     num_read = readblock(&fil, my_block);

//     ret = i2s_write(dev_i2s, my_block, BLOCK_SIZE);
//     if (ret < 0) {
//       printf("Could not write TX buffer: err %d\n", ret);
//     }
//   }
//   //
//   /* Drain TX queue */
//   //  i think this just blocks until it runs out of data then goes back to
//   // the
//   //  stopped state
//   ret = i2s_trigger(dev_i2s, I2S_DIR_TX, I2S_TRIGGER_DRAIN);
//   if (ret < 0) {
//     printf("Could not trigger I2S tx\n");
//     return ret;
//   }
//   printf("Done\n");
//   return 0;
// }

K_THREAD_DEFINE(audio_tid, AUDIO_STACK_SIZE, audio_entry_point, NULL, NULL,
                NULL, AUDIO_PRIORITY, 0, 1000);
```
